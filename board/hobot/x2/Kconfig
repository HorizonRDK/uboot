## board/hobot/x2/Kconfig
```kconfig
if TARGET_X2

config ARCH_X2
	bool
        default y

config SYS_BOARD
	default "x2"

config SYS_VENDOR
	default "hobot"

config SYS_SOC
	default "x2"

config SYS_CONFIG_NAME
	default "x2"

config DDR_BOOT
        bool "Support boot from ddr for x2 fpga board(tmp)"
        default n
        help
        ┆ Enabling this will make a U-Boot can load kernel image and dtb image
        ┆ from DDR.

endif
```

## board/hobot/x2_fpga/Kconfig
```kconfig
if TARGET_X2_FPGA

config ARCH_X2
	bool
	default y

config SYS_BOARD
	default "x2_fpga"

config SYS_VENDOR
	default "hobot"

config SYS_SOC
	default "x2-fpga"

config SYS_CONFIG_NAME
	default "x2_fpga"

endif
```

## board/hobot/x3/Kconfig
```kconfig
if TARGET_X3

config SYS_BOARD
	default "x3"

config SYS_VENDOR
	default "hobot"

config SYS_SOC
	default "x3"

config SYS_CONFIG_NAME
	default "x3"

endif
```

## board/hobot/x3_fpga/Kconfig
```kconfig
if TARGET_X3_FPGA

config SYS_BOARD
	default "x3_fpga"

config SYS_VENDOR
	default "hobot"

config SYS_SOC
	default "x3-fpga"

config SYS_CONFIG_NAME
	default "x3_fpga"

endif
```

## board/hobot/xj3/Kconfig
```kconfig
if TARGET_XJ3

config SYS_BOARD
	default "xj3"

config SYS_VENDOR
	default "hobot"

config SYS_SOC
	default "xj3"

config SYS_CONFIG_NAME
	default "xj3"

endif
```

## board/horizon/x2/Kconfig
```kconfig
menu "X2 mode board set"
config X2_BOARD_SOM
        bool "som -support som board"
        help
          som mode set.

config X2_BOARD_SVB
        bool "svb -support svb board"
        help
          svb mode set.

config X2_MODE_UART
        bool "uart -support uart mode"
        help
          uart mode enable.

config X2_MODE_AP
        bool "ap -support ap mode"
        help
          ap mode enable.

config X2_MODE_EMMC
        bool "emmc -support emmc mode"
        help
          emmc mode enable.

config X2_MODE_NOR
        bool "nor -support nor mode"
        help
          ap mode enable.
endmenu

if TARGET_X2

config ARCH_X2
	bool
        default y

config SYS_BOARD
	default "x2"

config SYS_VENDOR
	default "horizon"

config SYS_SOC
	default "x2"

config SYS_CONFIG_NAME
	default "x2"

endif
```

## board/horizon/x2/x2-image-uboot.its
```
/dts-v1/;

/ {
	description = "U-Boot fitImage for X2 u-boot";
	#address-cells = <1>;

	images {
		uboot {
			description = "X2 U-Boot (64-bit)";
			data = /incbin/("/home/taolei/my-gitlab/u-boot/u-boot.bin");
			type = "kernel";
			arch = "arm64";
			os = "u-boot";
			compression = "none";
			load = <0x20000000>;
			entry = <0x20000000>;
		};
	};

	configurations {
		default = "config-1";
		config-1 {
			description = "Boot U-Boot";
			kernel = "uboot";
		};
	};
};
```

## board/horizon/x2/x2-image.its
```
/dts-v1/;

/ {
	description = "U-Boot fitImage for X2 kernel";
	#address-cells = <1>;

	images {
		kernel {
			description = "X2 Linux kernel";
			data = /incbin/("Image");
			type = "kernel";
			arch = "arm64";
			os = "linux";
			compression = "none";
			load = <0x00080000>;
			entry = <0x00080000>;
		};

		fdt-1 {
			description = "X2 Flattened Device Tree blob";
			data = /incbin/("hobot-x2-soc.dtb");
			type = "flat_dt";
			arch = "arm64";
			compression = "none";
		};
	};

	configurations {
		default = "config-1";

		config-1 {
			description = "Boot Linux kernel with FDT blob";
			kernel = "kernel";
			fdt = "fdt-1";
		};
	};
};
```

## board/horizon/x2a_fpga/Kconfig
```kconfig
if TARGET_X2A_FPGA

config ARCH_X2
	bool
        default y

config SYS_BOARD
	default "x2"

config SYS_VENDOR
	default "horizon"

config SYS_SOC
	default "x2"

config SYS_CONFIG_NAME
	default "x2a_fpga"

endif
```

## drivers/clk/hobot/Kconfig
```kconfig
config CLK_HB
    bool "Enable clock driver for hobot"
	depends on ARCH_HOBOT && CLK
	default y
	help
		This clock driver adds support for clock related settings for
		hobot platform.
```

## drivers/crypto/Kconfig
```kconfig
menu "Hardware crypto devices"

source drivers/crypto/fsl/Kconfig

config HBOT_SECURE_ENGINE
		bool "Hbot Secure component driver support"
		default n
		help
			This supports secure engine drivers.

			Note that this application programming interface is EXPERIMENTAL
			and hence SUBJECT TO CHANGE WITHOUT NOTICE while it stabilizes.
endmenu
```

## drivers/mtd/nand/spi/Kconfig
```kconfig
menuconfig MTD_SPI_NAND
	bool "SPI NAND device Support"
	depends on DM_MTD && DM_SPI
	select MTD_NAND_CORE
	select SPI_MEM
	help
	  This is the framework for the SPI NAND device drivers.

	config SPINAND_ESMT
	bool "Enable ESMT spi-nand detect"
	default n
	depends on MTD_SPI_NAND
	help
	  This option will enable ESMT spinand flash detection, which will
	  disable Micron spinand flash detection. If unsure, please select n
```

## drivers/scomp/Kconfig
```kconfig
config HBOT_SECURE_COMPONENT
		bool "Hbot Secure component driver support"
		default y
        	help
			This supports secure component drivers.
			
			Note that this application programming interface is EXPERIMENTAL
			and hence SUBJECT TO CHANGE WITHOUT NOTICE while it stabilizes.
```

## drivers/video/hobot/Kconfig
```kconfig
menuconfig VIDEO_HOBOT
	bool "Enable HOBOT video support"
	depends on DM_VIDEO
	help
	  This chapter configures the display functions on the XJ3 platform.

config VIDEO_HOBOT_XJ3
	bool "HOBOT XJ3 Display Support"
	depends on VIDEO_HOBOT
	help
	  This enables hobot xj3 display support on uboot.

config XJ3_DISPLAY_DEBUG
    bool "Enable XJ3 Display Debug"
	depends on VIDEO_HOBOT && VIDEO_HOBOT_XJ3
	help
	  This enables display debug message.
```
